## drivers/xenomai/i2c/Kconfig
```kconfig
menu "Real-time I2C master drivers"

config XENO_DRIVERS_I2C
       depends on I2C
       tristate

config XENO_DRIVERS_I2C_BCM2708
	depends on ARCH_BCM2708 || ARCH_BCM2709
	select XENO_DRIVERS_I2C
	tristate "Support for BCM2708 I2C"
	help

	Enables support for the I2C0 controller available from
	Broadcom's BCM2708 SoC.

config XENO_DRIVERS_I2C_DEBUG
       depends on XENO_DRIVERS_I2C
       bool "Enable I2C core debugging features"
       
endmenu
```
